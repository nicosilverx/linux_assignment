## conf/layer.conf
```bitbake
# We have a conf and classes directory, add to BBPATH
BBPATH .= ":${LAYERDIR}"

# We have recipes-* directories, add to BBFILES
BBFILES += "${LAYERDIR}/recipes-*/*/*.bb \
            ${LAYERDIR}/recipes-*/*/*.bbappend"

BBFILE_COLLECTIONS += "meta-ppg"
BBFILE_PATTERN_meta-ppg = "^${LAYERDIR}/"
BBFILE_PRIORITY_meta-ppg = "6"

LAYERDEPENDS_meta-ppg = "core"
LAYERSERIES_COMPAT_meta-ppg = "dunfell"
```
